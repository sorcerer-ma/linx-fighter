## firmware/src/sdkconfig.defaults.local
```kconfig
# 本机验证用配置（不入库）
CONFIG_BOARD_TYPE_YUNLIAO_S3=y
CONFIG_USE_DEVICE_AEC=y
CONFIG_OTA_URL="https://xrobo.qiniuapi.com/v1/ota/"
CONFIG_FLASH_NONE_ASSETS=y
# 控制台走 USB Serial/JTAG：日志与 HUD 串口命令共用一路
CONFIG_ESP_CONSOLE_USB_SERIAL_JTAG=y
CONFIG_LV_USE_SNAPSHOT=y
# 矢量图元绘制（表情用）
CONFIG_LV_BIN_DECODER_RAM_LOAD=y
CONFIG_LV_CACHE_DEF_SIZE=4194304
CONFIG_LV_FONT_MONTSERRAT_12=y
CONFIG_LV_USE_RLE=y
```
